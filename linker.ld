/* linker.ld */
SECTIONS {
    . = 0xFFFF_8001_0000_0000;

    .text : {
        *(.text*)
    }

    .rodata : {
        *(.rodata*)
    }

    .data : {
        *(.data*)
    }

    .bss : {
        *(.bss*)
    }
}
